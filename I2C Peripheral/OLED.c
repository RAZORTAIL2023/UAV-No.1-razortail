#include "OLED.h"


void OLED_setCursor(uint8_t Y, uint8_t X)
{
	//Y:0~7 X:0~127
	I2C_write(0x78,0x00,0xB0 | Y);             //设置Y位置
	I2C_write(0x78,0x00,0x10 | ((X&0xF0)>>4)); //设置X位置高4位
	I2C_write(0x78,0x00,0x00 | ((X&0x0F)>>0)); //设置X位置低4位
}

void OLED_clear()
{
	for (uint8_t j = 0; j < 8; j++)
	{
		OLED_setCursor(j, 0);
		for(uint8_t i = 0; i < 128; i++)I2C_write(0x78,0x40,0x00);
	}
}

const uint8_t OLED_F8x16[][16];
void OLED_show_char(uint8_t line, uint8_t colume, char _char)
{
	OLED_setCursor((line-1)*2+0, (colume-1)*8);	//设置光标位置在上半部分
	for (uint8_t i=0; i<8; i++)
		I2C_write(0x78,0x40,OLED_F8x16[_char - ' '][i + 0]); //显示上半部分内容
	
	OLED_setCursor((line-1)*2+1, (colume-1)*8); //设置光标位置在下半部分
	for (uint8_t i=0; i<8; i++)
		I2C_write(0x78,0x40,OLED_F8x16[_char - ' '][i + 8]); //显示下半部分内容
}

void OLED_show_string(uint8_t line, uint8_t colume, char *String)
{
	for (uint8_t i=0; String[i]!='\0'; i++)
		OLED_show_char(line, colume + i, String[i]);
}

void OLED_show_number(uint8_t line, uint8_t colume, uint32_t number, uint8_t length)
{
	for (uint8_t i=0; i<length; i++)
		OLED_show_char(line, colume + i, number / (uint32_t)pow(10, length - i - 1) % 10 + '0');
}

void OLED_show_signedNumber(uint8_t line, uint8_t colume, int32_t number, uint8_t length)
{
	uint8_t i;
	uint32_t number1;
	if (number >= 0)
	{
		OLED_show_char(line, colume, '+');
		number1 = number;
	}
	else
	{
		OLED_show_char(line, colume, '-');
		number1 = -number;
	}
	for (i = 0; i < length; i++)							
	{
		OLED_show_char(line, colume + i + 1, number1 / (uint32_t)pow(10, length - i - 1) % 10 + '0');
	}
}

void OLED_show_hexNumber(uint8_t line, uint8_t colume, uint32_t number, uint8_t length)
{
	for (uint8_t i=0; i<length; i++)							
	{
		uint8_t SingleNumber = number / (uint32_t)pow(16, length - i - 1) % 16;
		if (SingleNumber < 10)
			OLED_show_char(line, colume + i, SingleNumber + '0');
		else
			OLED_show_char(line, colume + i, SingleNumber - 10 + 'A');
	}
}

void OLED_show_binNumber(uint8_t line, uint8_t colume, uint32_t number, uint8_t length)
{
	for (uint8_t i = 0; i < length; i++)
		OLED_show_char(line, colume + i, number / (uint32_t)pow(2, length - i - 1) % 2 + '0');
}

void OLED_show_floatNumber(uint8_t line, uint8_t colume, float number, uint8_t length, uint8_t decimal_places)
{
	uint32_t round_number = fabsf(number) * (uint32_t)pow(10, decimal_places);
	length = length + 2; //加一位符号位、加一位小数点
	for (uint8_t i=1; i<=length; i++)
	{
		if(i == 1)                            //符号位
		{
			if(number>=0)     OLED_show_char(line, colume, '+');
			else if(number<0) OLED_show_char(line, colume, '-');
		}
		else if(i <  length - decimal_places) //整数部分
			OLED_show_char(line, colume+i-1, round_number / (uint32_t)pow(10, length-2-(i-1)) % 10 + '0');
		else if(i == length - decimal_places) //小数点
			OLED_show_char(line, colume+i-1,'.');
		else if(i >  length - decimal_places) //小数部分
			OLED_show_char(line, colume+i-1, round_number / (uint32_t)pow(10, length-2-(i-2)) % 10 + '0');
	}
}

void OLED_init()
{
	delay_s(1);//上电延时
	I2C_Hardware_wiring();
	
	I2C_write(0x78,0x00,0xAE);	//关闭显示
	
	I2C_write(0x78,0x00,0xD5);	//设置显示时钟分频比/振荡器频率
	I2C_write(0x78,0x00,0x80);
	
	I2C_write(0x78,0x00,0xA8);	//设置多路复用率
	I2C_write(0x78,0x00,0x3F);
	
	I2C_write(0x78,0x00,0xD3);	//设置显示偏移
	I2C_write(0x78,0x00,0x00);
	
	I2C_write(0x78,0x00,0x40);	//设置显示开始行
	
	I2C_write(0x78,0x00,0xA1);	//设置左右方向，0xA1正常 0xA0左右反置
	
	I2C_write(0x78,0x00,0xC8);	//设置上下方向，0xC8正常 0xC0上下反置
	
	I2C_write(0x78,0x00,0xDA);	//设置COM引脚硬件配置
	I2C_write(0x78,0x00,0x12);
	
	I2C_write(0x78,0x00,0x81);	//设置对比度控制
	I2C_write(0x78,0x00,0xCF);
	
	I2C_write(0x78,0x00,0xD9);	//设置预充电周期
	I2C_write(0x78,0x00,0xF1);
	
	I2C_write(0x78,0x00,0xDB);	//设置VCOMH取消选择级别
	I2C_write(0x78,0x00,0x30);
	
	I2C_write(0x78,0x00,0xA4);	//设置整个显示打开/关闭
	
	I2C_write(0x78,0x00,0xA6);	//设置正常/倒转显示
	
	I2C_write(0x78,0x00,0x8D);	//设置充电泵
	I2C_write(0x78,0x00,0x14);
	
	I2C_write(0x78,0x00,0xAF);	//开启显示
	
	OLED_clear();				//OLED清屏
}

//OLED字模库，宽8像素，高16像素
const uint8_t OLED_F8x16[][16]={
	0x00,0x00,0x00,0x00,0x00,0x00,0x00,0x00,
	0x00,0x00,0x00,0x00,0x00,0x00,0x00,0x00,//  0
	
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	0x00,0x00,0x00,0x00,0x00,0x00,0x00,0x00,//~ 94
};
